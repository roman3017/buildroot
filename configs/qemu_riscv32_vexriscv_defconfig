## configs/qemu_riscv32_vexriscv_defconfig
```kconfig
# Target Options
BR2_RISCV_ISA_RVI=y
BR2_RISCV_ISA_RVM=y
BR2_RISCV_ISA_RVA=y
# BR2_riscv_g is not set
BR2_riscv_custom=y
BR2_RISCV_ISA_CUSTOM_RVM=y

# Architecture
BR2_riscv=y
BR2_RISCV_32=y

# System
BR2_SYSTEM_DHCP=""
BR2_TARGET_GENERIC_GETTY=y
BR2_TARGET_GENERIC_GETTY_PORT="hvc0"

# Filesystem
BR2_TARGET_ROOTFS_CPIO=y

# Linux headers same as kernel
BR2_KERNEL_HEADERS_AS_KERNEL=y

# Kernel
BR2_LINUX_KERNEL=y
BR2_LINUX_KERNEL_LATEST_VERSION=y
BR2_LINUX_KERNEL_USE_ARCH_DEFAULT_CONFIG=y
BR2_LINUX_KERNEL_CONFIG_FRAGMENT_FILES="board/qemu/riscv32-vexriscv/linux.config.fragment"
BR2_LINUX_KERNEL_VMLINUX=y

# Bootloader
BR2_TARGET_OPENSBI=y
BR2_TARGET_OPENSBI_USE_PLAT=y
BR2_TARGET_OPENSBI_PLAT="qemu/virt"
```
